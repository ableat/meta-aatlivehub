## conf/layer.conf
```bitbake
# We have a conf and classes directory, add to BBPATH
BBPATH := "${BBPATH}:${LAYERDIR}"
# We have a packages directory, add to BBFILES
BBFILES := "${BBFILES} ${LAYERDIR}/recipes-*/*/*.bb \
           ${LAYERDIR}/recipes-*/*/*.bbappend"
BBFILE_COLLECTIONS += "aatlivehub"
BBFILE_PATTERN_aatlivehub := "^${LAYERDIR}/"
BBFILE_PRIORITY_aatlivehub := "5"
LAYERSERIES_COMPAT_aatlivehub = "poky"
```
